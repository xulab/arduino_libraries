#include "OLED_80XX.h"
const unsigned char F6x8[][6] =		
{
0x00, 0x00, 0x00, 0x00, 0x00, 0x00,// sp
0x00, 0x00, 0x00, 0x2f, 0x00, 0x00,// !
0x00, 0x00, 0x07, 0x00, 0x07, 0x00,// "
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0x14, 0x14, 0x14, 0x14, 0x14, 0x14,// horiz lines
};
/****************************************8*16************************************/
const unsigned char F8X16[]=	  
{
  0x00,0x00,0x00,0x00,0x00,0x00,0x00,0x00,0x00,0x00,0x00,0x00,0x00,0x00,0x00,0x00,// 0
  0x00,0x00,0x00,0xF8,0x00,0x00,0x00,0x00,0x00,0x00,0x00,0x33,0x30,0x00,0x00,0x00,//! 1
  0x00,0x10,0x0C,0x06,0x10,0x0C,0x06,0x00,0x00,0x00,0x00,0x00,0x00,0x00,0x00,0x00,//" 2
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  0x00,0x06,0x01,0x01,0x02,0x02,0x04,0x04,0x00,0x00,0x00,0x00,0x00,0x00,0x00,0x00,//~ 94
};


// #define D_PORT PORTA
// #define C_PORT PORTL

// #define CS_H _BV(PORTL0)
// #define RES_H _BV(PORTL1)
// #define DC_H _BV(PORTL2)
// #define RW_H _BV(PORTL3)
// #define RD_H _BV(PORTL4)
// #define CMD_MASK CS_H | RES_H | DC_H | RW_H | RD_H

#define CS_H  digitalWrite(cs , HIGH)
#define CS_L  digitalWrite(cs , LOW)
#define RES_H  digitalWrite(res  ,HIGH)
#define RES_L digitalWrite(res , LOW)
#define DC_H digitalWrite(dc , HIGH)
#define DC_L  digitalWrite(dc , LOW)
#define RW_H  digitalWrite(rw , HIGH)
#define RW_L  digitalWrite(rw , LOW)
#define RD_H  digitalWrite(rd , HIGH)
#define RD_L  digitalWrite(rd , LOW)

// #define INIT_WR_CMD C_PORT = RD_H | RES_H | RW_H
#define INIT_WR_CMD  DC_L; CS_L; RD_H; RES_H; RW_H

// #define WR_CMD C_PORT = RD_H | RES_H; C_PORT = RD_H | RES_H | RW_H
#define WR_CMD DC_L; CS_L; RW_L; RD_H; RW_H

// #define CMD_FIN C_PORT = RD_H | RES_H | RW_H | CS_H	
#define CMD_FIN DC_L; RD_H; RES_H; RW_H; CS_H;

// #define INIT_WR_DATA C_PORT = DC_H | RD_H | RES_H | RW_H
#define INIT_WR_DATA DC_H; CS_L; RD_H; RES_H; RW_H

// #define WR_DATA C_PORT = DC_H | RD_H | RES_H; C_PORT = DC_H | RD_H | RES_H | RW_H
#define WR_DATA DC_H; CS_L; RW_L; RD_H; RW_H
 				
// #define DATA_FIN C_PORT = DC_H | RD_H | RES_H | RW_H | CS_H	
#define DATA_FIN DC_H; RD_H; RES_H; RW_H; CS_H	

// #define RESET C_PORT = CS_H | RES_H | DC_H | RW_H | RD_H; C_PORT = CS_H | DC_H | RW_H | RD_H; C_PORT = CS_H | RES_H | DC_H | RW_H | RD_H
#define RESET CS_H; RES_H; DC_H; RW_H; RD_H;\
 			CS_H; RES_L; DC_H; RW_H; RD_H; \
 			CS_H; RES_H; DC_H; RW_H; RD_H

#define CMD 0
#define DATA 1

#define XLevelL		0x02
#define XLevelH		0x10
#define Max_Column	128
#define Max_Row		64
#define	Brightness	0xFF 
#define X_WIDTH 	128
#define Y_WIDTH 	64	

#define MAX_TEMP_STR 12
byte cs;
byte res;
byte rw;
byte dc;
byte rd;
byte dataPort[8];
	
char temp_str[MAX_TEMP_STR]="";

void dataWrite(byte data){
 for(byte i = 0 ; i< 8; i++) digitalWrite(dataPort[i], data & _BV(i));
}

void wr_byte_cmd(unsigned char data)
{
	INIT_WR_CMD;
	// D_PORT = data;
	dataWrite(data);
	WR_CMD;
	CMD_FIN;
}
void wr_byte_cmd2(unsigned char data1, unsigned char data2)
{
	INIT_WR_CMD;
	// D_PORT = data1;
	dataWrite(data1);
	WR_CMD;
	// D_PORT = data2;
	dataWrite(data2);
	WR_CMD;
	CMD_FIN;
}
void wr_byte_data(unsigned char data)
{
	INIT_WR_DATA;
	// D_PORT = data;
	dataWrite(data);
	WR_DATA;
	DATA_FIN;
}
void WR_Bytes(const unsigned char * data, unsigned char mode, unsigned char num)
{
	INIT_WR_DATA;
	if(mode)
	{
		for(byte i=0; i<num; i++)
			{
				// D_PORT = data[i];
				dataWrite(data[i]);
				WR_DATA;	
			}
	}
	else
	{
		for(byte i=0; i<num; i++)
			{
				// D_PORT = ~data[i];
				dataWrite(~data[i]);
				WR_DATA;	
			}
	}
	DATA_FIN;
}

void WR_8_Byte(const unsigned char * data, unsigned char mode)
{
	INIT_WR_DATA;
	if(mode)
	{

		// D_PORT = data[0];
		// WR_DATA;
		// D_PORT = data[1];
		// WR_DATA;
		// D_PORT = data[2];
		// WR_DATA;
		// D_PORT = data[3];
		// WR_DATA;
		// D_PORT = data[4];
		// WR_DATA;
		// D_PORT = data[5];
		// WR_DATA;
		// D_PORT = data[6];
		// WR_DATA;
		// D_PORT = data[7];
		// WR_DATA;
		for(byte i = 0; i < 8; i++){
				dataWrite(data[i]);
				WR_DATA;
		}
	}
	else
	{
		// D_PORT = ~data[0];
		// WR_DATA;
		// D_PORT = ~data[1];
		// WR_DATA;
		// D_PORT = ~data[2];
		// WR_DATA;
		// D_PORT = ~data[3];
		// WR_DATA;
		// D_PORT = ~data[4];
		// WR_DATA;
		// D_PORT = ~data[5];
		// WR_DATA;
		// D_PORT = ~data[6];
		// WR_DATA;
		// D_PORT = ~data[7];
		// WR_DATA;
		for(byte i = 0; i < 8; i++){
				dataWrite(~data[i]);
				WR_DATA;
		}

	}
	DATA_FIN;
}

void WR_6_Byte(const unsigned char * data, unsigned char mode)
{
	INIT_WR_DATA;
	if(mode)
	{
		// D_PORT = data[0];
		// WR_DATA;
		// D_PORT = data[1];
		// WR_DATA;
		// D_PORT = data[2];
		// WR_DATA;
		// D_PORT = data[3];
		// WR_DATA;
		// D_PORT = data[4];
		// WR_DATA;
		// D_PORT = data[5];
		// WR_DATA;
		for(byte i = 0; i < 6; i++){
				dataWrite(data[i]);
				WR_DATA;
		}
	
	}
	else
	{
		// D_PORT = ~data[0];
		// WR_DATA;
		// D_PORT = ~data[1];
		// WR_DATA;
		// D_PORT = ~data[2];
		// WR_DATA;
		// D_PORT = ~data[3];
		// WR_DATA;
		// D_PORT = ~data[4];
		// WR_DATA;
		// D_PORT = ~data[5];
		// WR_DATA;
		for(byte i = 0; i < 6; i++){
				dataWrite(~data[i]);
				WR_DATA;
		}
	}
	DATA_FIN;
}


void OLED_Class::ClearLine(unsigned char y)
{
	SmallString(0,y,"                      ",NOM_DIS);	
}

void OLED_Class::ClearScreen()  
{  
	unsigned char i,n;		    
	for (i=0; i<8; i++)ClearLine(i);
}

void OLED_Class::Set_Pos(unsigned char x, unsigned char y) 
{ 
	wr_byte_cmd(0xb0+y);
	wr_byte_cmd(((x&0xf0)>>4)|0x10);
	wr_byte_cmd((x&0x0f)|0x00); 	
}

void Display_On()
{
	wr_byte_cmd(0X8D);  //SET DCDC
	wr_byte_cmd(0X14);  //DCDC ON
	wr_byte_cmd(0XAF);  //DISPLAY ON
}

void Display_Off()
{
	wr_byte_cmd(0X8D);  //SET DCDC
	wr_byte_cmd(0X10);  //DCDC OFF
	wr_byte_cmd(0XAE);  //DISPLAY OFF
}	

void OLED_Class::Init(byte _CS,byte _RES,byte _RW,byte _DC,byte _RD, byte* data)
{
	// DDRA = 0xFF;
	// DDRL = CMD_MASK;	byte cs;
	cs = _CS;
	res = _RES;
	rw = _RW;
	dc = _DC;
	rd = _RD;
	for (byte i=0; i<8; i++) dataPort[i] = data[i];
	
	pinMode(cs, OUTPUT);
	pinMode(res, OUTPUT);
	pinMode(rw, OUTPUT);
	pinMode(dc, OUTPUT);
	pinMode(rd, OUTPUT);
	for (byte i=0; i<8; i++) pinMode(dataPort[i], OUTPUT);
	RESET;
	
	wr_byte_cmd(0xFD); //Command Lock
	wr_byte_cmd(0x12); //unlock oled
	wr_byte_cmd(0xAE); //Set Display Off 
	wr_byte_cmd2(0xD5,0xA0); //Set Display Clock Divide Ratio/Oscillator Frequency
	wr_byte_cmd2(0xA8,0x3F); //Set Multiplex Ratio 
	wr_byte_cmd2(0xD3,0X00); //Set Display Offset
	wr_byte_cmd(0x40); //Set Display Start Line 
	wr_byte_cmd(0XA1); //Set Segment Re-Map. Normal horizantal.
	wr_byte_cmd(0xC8); //Set COM Output Scan Direction. Normal vertical. 
	// wr_byte_cmd(0XA0); //Set Segment Re-Map.Inverse horizantal.
	// wr_byte_cmd(0xC0); //Set COM Output Scan Direction. Inverse vertical.
	wr_byte_cmd2(0xDA,0x12); //Set COM Pins Hardware Configuration
	wr_byte_cmd2(0x81,0xFF); //Set Current Control 
	wr_byte_cmd2(0xD9,0x82); //Set Pre-Charge Period  
	wr_byte_cmd2(0xDB,0x34); //Set VCOMH Deselect Level 	 
	wr_byte_cmd(0xA4); //Set Entire Display On/Off
	wr_byte_cmd(0xA6); //Set Normal/Inverse Display 
	wr_byte_cmd(0xAF); //Set Display On 
	ClearScreen();
	Set_Pos(0,0); 
	
}  

void OLED_Class::BigChar(unsigned char x,unsigned char y,unsigned char chr, char mode)
{      	
	unsigned char c=0,i=0,num=8;	
	c=chr-' ';
	num = (x<=120)?8:(128-x);
	Set_Pos(x,y);	
	// WR_8_Byte(&(F8X16[c*16]), mode);
	WR_Bytes(&(F8X16[c*16]), mode,num);
	Set_Pos(x,y+1);
	WR_Bytes(&(F8X16[c*16+8]), mode,num);
	// WR_8_Byte(&(F8X16[c*16+8]), mode);
}
void OLED_Class::SmallChar(unsigned char x,unsigned char y,unsigned char chr, char mode)
{      	
	unsigned char c=0,i=0,num=6;	
	c=chr-' ';
	num = (x<=122)?6:(128-x);
	Set_Pos(x,y);
	// WR_6_Byte(&(F6x8[c][0]), mode);
	WR_Bytes(&(F6x8[c][0]), mode,num);
}

void OLED_Class::SmallString(unsigned char x,unsigned char y, char *chr,char mode)
{
	unsigned char j=0;
	// x=x*6;
	while ((chr[j]!='\0') && (x < 127))
	{		
		SmallChar(x,y,chr[j],mode);
		x+=6;
		j++;
	}
}

void OLED_Class::SmallString_len(unsigned char x,unsigned char y, char *chr,char mode,unsigned char len)
{
	unsigned char j=0;
	// x=x*6;
	while ((chr[j]!='\0') && (x < 127) && (j<len))
	{		
		SmallChar(x,y,chr[j],mode);
		x+=6;
		j++;
	}
}

void OLED_Class::BigString(unsigned char x,unsigned char y, char *chr,char mode)
{
	unsigned char j=0;
	// x=x*8;
	while ((chr[j]!='\0') && (x < 127))
	{		
		BigChar(x,y,chr[j],mode);
		x+=8;
		j++;
	}
}

void OLED_Class::BigString_len(unsigned char x,unsigned char y, char *chr,char mode, unsigned char len)
{
	unsigned char j=0;
	// x=x*8;
	while ((chr[j]!='\0') && (x < 127) && (j<len))
	{		
		BigChar(x,y,chr[j],mode);
		x+=8;
		j++;
	}
}

void OLED_Class::SmallInt(unsigned char x,unsigned char y,long data, byte length,char mode)
{
  unsigned r;
  char * res_str;
  byte neg_flag=0;
  res_str = &(temp_str[MAX_TEMP_STR-1]);

  if(data<0) {data=abs(data);neg_flag=1;}

  for(int i=0; i<MAX_TEMP_STR; i++)
  {
    r = data % 10;
    data = data / 10;
    res_str--;
    *res_str = r+'0';
    if ((data == 0) && ((i+1)>=length)) break;
  }
  if(neg_flag)
  {
    res_str--;
    *res_str='-';
  }
  SmallString(x,y,res_str,mode);
}

void OLED_Class::BigInt(unsigned char x,unsigned char y,long data, byte length,char mode)
{
  unsigned r;
  char * res_str;
  byte neg_flag=0;
  res_str = &(temp_str[MAX_TEMP_STR-1]);

  if(data<0) {data=abs(data);neg_flag=1;}

  for(int i=0; i<MAX_TEMP_STR; i++)
  {
    r = data % 10;
    data = data / 10;
    res_str--;
    *res_str = r+'0';
    if ((data == 0) && ((i+1)>=length)) break;
  }
  if(neg_flag)
  {
    res_str--;
    *res_str='-';
  }
  BigString(x,y,res_str,mode);
}

OLED_Class OLED;
